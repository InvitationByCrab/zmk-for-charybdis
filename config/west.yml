## config/west.yml
```yaml
manifest:
  remotes:
    - name: zmkfirmware
      url-base: https://github.com/zmkfirmware
    - name: badhi
      url-base: https://github.com/badhi
  projects:
    - name: zmk-pmw3610-driver  # GitHub에 있는 실제 저장소 이름
      remote: badhi
      path: zmk                 # 로컬에 저장될 폴더 이름 (ZMK 빌드 시스템이 이 이름을 찾음)
      revision: main
      import: app/west.yml
  self:
    path: config
```
